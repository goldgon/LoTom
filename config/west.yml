## config/west.yml
```yaml
manifest:
  remotes:
    - name: zmkfirmware
      url-base: https://github.com/zmkfirmware
    - name: mctechnology17
      url-base: https://github.com/mctechnology17
    - name: badjeff
      url-base: https://github.com/badjeff
    - name: englmaxi
      url-base: https://github.com/englmaxi
    - name: te9no
      url-base: https://github.com/te9no
    - name: iwk7273
      url-base: https://github.com/iwk7273
  projects:
    - name: zmk
      remote: zmkfirmware
      revision: v0.3
      import: app/west.yml
    - name: zmk-pmw3610-driver
      remote: badjeff
      revision: zmk-0.3
    - name: zmk-dongle-display
      remote: te9no
      revision: main
    - name: zmk-oled-adapter
      remote: mctechnology17
      revision: main
    - name: zmk-nice-oled
      remote: mctechnology17
      revision: main
    - name: zmk-feature-xy_clipper
      remote: iwk7273
      revision: main
  self:
    path: config
```
